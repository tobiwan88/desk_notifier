## firmware/main/Kconfig.projbuild
```kconfig
menu "Desk notifier"
    choice DESK_BOARD
        prompt "Board (sets the pin defaults below)"
        default DESK_BOARD_NOTIFIER_V1 if IDF_TARGET_ESP32S3
        default DESK_BOARD_BREADBOARD
        config DESK_BOARD_BREADBOARD
            bool "ESP32-C61 breadboard (display and BME688 on jumper wires)"
        config DESK_BOARD_NOTIFIER_V1
            bool "notifier-v1 PCB (ESP32-S3-WROOM-1, hardware/notifier-v1)"
    endchoice
    menu "Display pins (one GC9A01)"
        config DESK_LCD_PIN_SCLK
            int "SCLK GPIO"
            default 12 if DESK_BOARD_NOTIFIER_V1
            default 6
        config DESK_LCD_PIN_MOSI
            int "MOSI GPIO"
            default 11 if DESK_BOARD_NOTIFIER_V1
            default 5
        config DESK_LCD_PIN_DC
            int "DC GPIO"
            default 9 if DESK_BOARD_NOTIFIER_V1
            default 3
        config DESK_LCD_PIN_RST
            int "RST GPIO"
            default 14 if DESK_BOARD_NOTIFIER_V1
            default 2
        config DESK_LCD_PIN_CS
            int "Display CS GPIO"
            default 10 if DESK_BOARD_NOTIFIER_V1
            default 4
        config DESK_LCD_PIN_BL
            int "Backlight PWM GPIO (-1 = none, needs MOSFET mod)"
            default -1
    endmenu
    config DESK_LCD_SPI_HZ
        int "SPI clock (Hz), max 40 MHz"
        default 20000000
    config DESK_LCD_BGR
        bool "Panel colour order is BGR"
        default y
    config DESK_LCD_MIRROR_X
        bool "Mirror the panel horizontally"
        default y
    config DESK_LCD_MIRROR_Y
        bool "Mirror the panel vertically"
        default n
    config DESK_LCD_INVERT
        bool "Invert colours (most GC9A01 modules need this)"
        default y
    config DESK_STRIP_LINES
        int "Lines per DMA strip"
        default 20
    config DESK_STRIP_COUNT
        int "Number of DMA strip buffers"
        default 3
    menu "Sensor and button"
        config DESK_I2C_SDA
            int "BME688 SDA GPIO"
            default 4 if DESK_BOARD_NOTIFIER_V1
            default 22
        config DESK_I2C_SCL
            int "BME688 SCL GPIO"
            default 5 if DESK_BOARD_NOTIFIER_V1
            default 23
        config DESK_BME_ADDR
            hex "BME688 I2C address (0x76 SDO=GND, 0x77 SDO=VCC)"
            default 0x77
        config DESK_BTN
            int "Acknowledge button GPIO (to GND, -1 = none)"
            default 6 if DESK_BOARD_NOTIFIER_V1
            default 24
    endmenu
    menu "Pages"
        config DESK_FPS
            int "Frames per second of the animated pages"
            range 1 20
            default 10
        config DESK_PAGE_CLOCK_S
            int "Seconds on the clock page (0 = skip the page)"
            default 12
        config DESK_PAGE_AIR_S
            int "Seconds on the air (squirrel) page (0 = skip the page)"
            default 15
        config DESK_PAGE_DAY_S
            int "Seconds on the day (squirrel at home) page (0 = skip the page)"
            default 12
    endmenu
    menu "Squirrel's day (times as HHMM, 630 = 06:30; weekends and Bavarian holidays start 90 min later, no work)"
        config DESK_DAY_WAKE
            int "Wake up, coffee"
            range 0 2359
            default 630
        config DESK_DAY_WORK
            int "Start work (laptop open)"
            range 0 2359
            default 900
        config DESK_DAY_LUNCH
            int "Lunch (one hour)"
            range 0 2359
            default 1200
        config DESK_DAY_END
            int "End of work (laptop closes, then reading)"
            range 0 2359
            default 1800
        config DESK_DAY_BED
            int "Bedtime (sleeps until wake up)"
            range 0 2359
            default 2300
        config DESK_DAY_BIRTHDAY
            int "Birthday as MMDD (315 = 15 March, 0 = none): cake, party hat, garland"
            range 0 1231
            default 0
        config DESK_DAY_BIRTHDAY_NAME
            string "Name shown on the birthday"
            default ""
        config DESK_DAY_ANNIVERSARY
            int "Wedding anniversary as MMDD (614 = 14 June, 0 = none): rose, hearts"
            range 0 1231
            default 0
    endmenu
    menu "Weather (Open-Meteo, no API key)"
        config DESK_WEATHER_URL
            string "Forecast endpoint"
            default "http://api.open-meteo.com/v1/forecast"
        config DESK_WEATHER_LAT
            string "Latitude (console: set wx_lat)"
            default "48.137"
        config DESK_WEATHER_LON
            string "Longitude (console: set wx_lon)"
            default "11.575"
        config DESK_WEATHER_PLACE
            string "Place name on the page"
            default "Munich"
        config DESK_WEATHER_REFRESH_MIN
            int "Refresh interval (minutes)"
            range 10 180
            default 20
    endmenu
    config DESK_TZ
        string "POSIX timezone"
        default "CET-1CEST,M3.5.0,M10.5.0/3"
    config DESK_WIFI_SSID
        string "Wi-Fi SSID (overridable via UART console)"
        default ""
    config DESK_WIFI_PASSWORD
        string "Wi-Fi password"
        default ""
    config DESK_CLIP_MAX_BPS
        int "Sustained clip bytes/s the device can serve (measured by the fs benchmark)"
        default 1500000
    config DESK_TEST_CRASH_ON_BOOT
        bool "TEST ONLY: abort() right after start (exercises OTA rollback)"
        default n
    config DESK_OPEN_ACCESS
        bool "Anonymous access (no API token required); changeable at runtime with the console command `auth`"
        default y
    config DESK_MAX_CLIP_BYTES
        int "Maximum clip size in bytes"
        default 2097152
endmenu
```

## firmware/sdkconfig.defaults
```kconfig
CONFIG_IDF_TARGET="esp32s3"
CONFIG_ESPTOOLPY_FLASHSIZE_8MB=y
CONFIG_PARTITION_TABLE_CUSTOM=y
CONFIG_PARTITION_TABLE_CUSTOM_FILENAME="partitions.csv"
CONFIG_PARTITION_TABLE_FILENAME="partitions.csv"
CONFIG_COMPILER_OPTIMIZATION_PERF=y
CONFIG_FREERTOS_HZ=1000
CONFIG_SPI_MASTER_ISR_IN_IRAM=n
CONFIG_APP_ROLLBACK_ENABLE=y
CONFIG_ESP_TASK_WDT_EN=y
CONFIG_COMPILER_CXX_EXCEPTIONS=n
CONFIG_COMPILER_CXX_RTTI=n
CONFIG_ESP_CONSOLE_USB_SERIAL_JTAG=y
CONFIG_SPIRAM=y
CONFIG_SPIRAM_TRY_ALLOCATE_WIFI_LWIP=y
CONFIG_SPIRAM_MALLOC_ALWAYSINTERNAL=256
CONFIG_ESP_WIFI_STATIC_RX_BUFFER_NUM=4
CONFIG_ESP_WIFI_DYNAMIC_RX_BUFFER_NUM=16
CONFIG_ESP_WIFI_TX_BUFFER_TYPE=1
CONFIG_ESP_WIFI_DYNAMIC_TX_BUFFER_NUM=16
CONFIG_ESP_WIFI_IRAM_OPT=n
CONFIG_ESP_WIFI_RX_IRAM_OPT=n
CONFIG_ESP_WIFI_RX_BA_WIN=8
CONFIG_LWIP_MAX_SOCKETS=8
CONFIG_DESK_LCD_SPI_HZ=40000000
CONFIG_FREERTOS_PLACE_FUNCTIONS_INTO_FLASH=y
CONFIG_HEAP_PLACE_FUNCTION_INTO_FLASH=y
CONFIG_DESK_STRIP_LINES=10
# Bluetooth LE setup service (components/ble): NimBLE peripheral only, one phone at a time, bonds kept in NVS
CONFIG_BT_ENABLED=y
CONFIG_BT_NIMBLE_ENABLED=y
CONFIG_BT_NIMBLE_50_FEATURE_SUPPORT=n
CONFIG_BT_NIMBLE_ROLE_CENTRAL=n
CONFIG_BT_NIMBLE_ROLE_OBSERVER=n
CONFIG_BT_NIMBLE_MAX_CONNECTIONS=1
CONFIG_BT_NIMBLE_NVS_PERSIST=y
CONFIG_BT_NIMBLE_MAX_BONDS=3
```
